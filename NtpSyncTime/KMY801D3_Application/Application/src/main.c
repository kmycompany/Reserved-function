
#include "main.h"

#include "stm32f10x.h"
#include "stm32f10x_flash.h"
#include "stm32f10x_rcc.h"
#include "kmy_LCDDrv.h"

#include <stdio.h>
#include <string.h>
#include <stdlib.h>


#include "MenuOperate.h"
#include "lcd.h"
#include "key.h"
#include "SelfTest.h"
#include "kmy_LEDDrv.h"
#include "kmy_BeepDrv.h"
#include "kmy_Time.h"
#include "kmy_FlashDrv.h"
#include "kmy_EEPROMDrv.h"
#include "kmy_MagcardPADrv.h"
#include "kmy_USART1Drv.h"
#include "kmy_USART2Drv.h"
#include "kmy_USART3Drv.h"
#include "kmy_PrinterDrv.h"
#include "kmy_TamperDrv.h"
#include "kmy_Misc.h"
#include "kmy_BattaryDrv.h"
#include "kmy_psamDrv.h"

#include "gprs.h"
#include "SelfTest.h"
#include "global_variable.h"
#include "setting.h"
#include "Tool.h"
#include "CallRecord.h"
#include "EepromFileSystem.h"
#include "mypure_library.h"
#include "message.h"
#include "kmy_GprsDrv.h"
#include "kmy_wifi.h"

#include "FoodOrder.h"
#include "kmy_Adc.h"
#include "Version.h"

#include "Wifi.h"
#include "ntp.h"



extern unsigned char CurrentKey[33];
extern unsigned char MacKey[33];

//终端ID
char g_TermID[13] ;
char gEventflag=0;
//static char GetSignalflag=1; 


#if 1	//反显KMY
const unsigned char PoweronLogo[]=
{
	/*------------------------------------------------------------------------------
	;  若数据乱码，请检查字模格式设置，注意选择正确的取模方向和字节位顺序。
	;  源文件 / 文字 : D:\公司资料\KMY801D\document\KMY-128x64.bmp字模
	;  宽×高（像素）: 128×64
	;  字模格式/大小 : 单色点阵液晶字模，纵向取模，字节倒序/1024字节
	;  数据转换日期  : 2011-12-2 9:57:27
	------------------------------------------------------------------------------*/
	0xFF,0xFF,0xFF,0xFF,0xFF,0xFF,0xFF,0xFF,0xFF,0xFF,0xFF,0xFF,0xFF,0xFF,0xFF,0xFF,
	0xFF,0xFF,0xFF,0xFF,0xFF,0xFF,0xFF,0xFF,0xFF,0xFF,0xFF,0xFF,0xFF,0xFF,0xFF,0xFF,
	0xFF,0xFF,0x07,0x07,0x07,0x07,0x07,0xFF,0xFF,0x7F,0x3F,0x1F,0x07,0x07,0x07,0x87,
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	0xFD,0xFC,0xFD,0xFD,0xFF,0xFF,0xFF,0xFF,0xFF,0xFF,0xFF,0xFF,0xFF,0xFF,0xFF,0xFF,
};
#endif


const unsigned char logo[]=
{
	//kmy待机界面logo
	/*------------------------------------------------------------------------------
	;  若数据乱码，请检查字模格式设置，注意选择正确的取模方向和字节位顺序。
	;  宽×高（像素）: 52×18
	;  字模格式/大小 : 单色点阵液晶字模，纵向取模，字节倒序/156字节
	;  数据转换日期  : 2009-12-16 下午 03:01:27
	------------------------------------------------------------------------------*/
	0xff,0x53,0x53,0x53,0x57,0x7f,0x7f,0x5f,0x5f,0x57,0xd3,0xf3,0xf3,0xfb,0xff,0xff,
	0xff,0xff,0x53,0x53,0x53,0xd3,0x53,0x5f,0x7f,0xff,0xff,0x5f,0x53,0xd3,0x53,0x53,
	0x53,0xff,0xff,0xff,0xff,0xf3,0xf3,0xd3,0x53,0x5f,0x7f,0x7f,0x7f,0x5f,0x57,0xd3,
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	0x03,0x03,0x03,0x03,0x03,0x03,0x03,0x03,0x03,0x03,0x03,0x03,
};


//kmy库中提供一个1毫秒调用一次的函数
//必须有
void kmy_OneMiliSecondCallThread(void)
{
	static unsigned int cnt;
	static unsigned char dataledcnt;

	cnt++;
	
	if(gFlushDataFlag==1)
	{
		if(cnt%60==0)
		{
			dataledcnt++;
			if(dataledcnt%2==0)kmy_LedDataLedOn();
			else kmy_LedDataLedOff();
		}
	}
	else if(gFlushDataFlag==0)
	{
		kmy_LedDataLedOff();
		gFlushDataFlag=2;
	}	
}

void EventFunction(void)
{
	gEventflag=0;
	kmy_LcdClear();
	DrawTitle_to_row(2,"This is event test");
	WaitkeyAndAutoExit(10);

}

char MainMenuScreen(char *msg)
{
	const static struct MenuFuc_Language2 Menu[3] =
	{
		{"1.Latest Orders", "1.Latest Orders", Latest_Orders},		
		{"2.Confirm Orders", "2.Confirm Orders", Confirm_Orders},
		{"3.Reject Orders", "3.Reject Orders", Reject_Orders},
	};
	struct MenuOperate_Language2 MenuOp = { (struct MenuFuc_Language2*) Menu, 3, 0, 0, 0, MaxRowOneScr, 1, 0, 0};


	kmy_EnableDisableTime3(0);
	while (1)
	{
	
		MenuHandler_Language2 (&MenuOp);

		if (MenuOp.RetVal == KEY_Enter)
		{	
			MenuOp.FucRetVal = MenuOp.Menu->MenuFuc (msg);
			
			if (MenuOp.FucRetVal == KEY_WaitTimeout || MenuOp.FucRetVal == KEY_ReturnInitInterface)
			{
				CurProc = CurProc_Return;
				kmy_EnableDisableTime3(1);
				return MenuOp.FucRetVal;
			}
			else
			{
				clear_lcd();
				MenuOp.flashflag = 1;
			}
		}
		else
		{
			CurProc = CurProc_Return;
			kmy_EnableDisableTime3(1);
			return MenuOp.RetVal;
		}
	}
}


static char ProcStandbyKey(char *msg);
static void StandbyResponseUserMenu(unsigned char keyval)
{
	switch(keyval){
		case KEY0:
		break;

		case KEY1:	
		break;

		case KEY2:		
		break;
		
		case KEY3:	
		break;
		
		case KEY4:	
		break;
		
		case KEY5:		
		break;
		
		case KEY6:	
		break;
		
		case KEY7:		
		break;
		
		case KEY8:	
		
		break;
		
		case KEY9:	
		
		break;

		case KEYJING:	

		break;

		case KEYXING:		
		
		break;

		case KEY_Enter:	//确认
    		CurProc = MainMenuScreen;
    		CurProc_Return = ProcStandbyKey;
    		InitFlag = 1;
    		ShortcutKeyEnterFlag = 1;
    		break;

		case KEY_R2:	
		
		break;

		case KEY_R3:
    		CurProc = MainMenuScreen_Settings;
			CurProc_Return = ProcStandbyKey;
			InitFlag = 1;
			ShortcutKeyEnterFlag = 1;
			break;
			
		case KEY_R4:  //自测
    		CurProc=SelfTest;
    		CurProc_Return=ProcStandbyKey;
    		InitFlag = 1;
    		ShortcutKeyEnterFlag=1;
    		break;

		default:
		break;
	}
}


static void DisplayHourMinuteSecond(unsigned long second)
{
	unsigned long temp;
	unsigned char buff[4];

	temp=second%(24*60*60);
	temp=temp/(60*60);
	sprintf((char *)buff,"%02d:",temp);
	text_out(8,18,buff);

	temp=second%(60*60);
	temp=temp/60;
	sprintf((char *)buff,"%02d:",temp);
	text_out(3*6+8,18,buff);

	temp=second%60;
	sprintf((char *)buff,"%02d",temp);
	text_out(6*6+8,18,buff);
}


static void DisplayYearMothDayWeek(unsigned long second)
{
	unsigned char Buf[20];
	const unsigned char NumData[7][5]={		//宽×高（像素）: 4×5
		{0x1F,0x15,0x1F,0x00},      	//  0
		{0x00,0x00,0x1F,0x00},	        //  1
		{0x1D,0x15,0x17,0x00},	        //  2
		{0x15,0x15,0x1F,0x00},  		//  3
		{0x07,0x04,0x1F,0x00},  		//  4
		{0x17,0x15,0x1D,0x00},  		//  5
		{0x1F,0x15,0x1D,0x00}   		//  6
	};

	unsigned int year;
	unsigned char mon;
	unsigned char day;
	unsigned char weekday;

	memset(Buf,0,sizeof(Buf));		//年月日星期
	kmy_TimeGetTime(&year,&mon,&day,NULL,NULL,NULL,&weekday);
	sprintf((char *)Buf,"%04d-%02d-%02d",year,mon,day);
	text_out(0,34,Buf);
	draw_pic(NumData[weekday],61,35,4,5);
}

const unsigned char CSPNs[5][15]={"正在搜索网络","中国移动","中国联通","中国电信","其它网络"};
static const unsigned char* GetNetName(unsigned char *netname)
{
	if(strstr((const char *)netname,"CHINA MOBILE")!=NULL){			//中国移动
		return CSPNs[1];
	}
	else if(strstr((const char *)netname,"UNICOM")!=NULL){		//中国联通
		return CSPNs[2];
	}
	else if(strstr((const char *)netname,"CHINA TELECOM")!=NULL){	//中国电信
		return CSPNs[3];
	}
	else if(strstr((const char *)netname,"\"")!=NULL){		//其它网络
		return CSPNs[4];
	}
	else{
		return CSPNs[0];
	}
}



const unsigned char pstr[5][24]={	
	{0xF0,0xFC,0x04,0x04,0x04,0x04,0x04,0x04,0x04,0x04,0x04,0xFC,0x00,0x03,0x02,0x02,0x02,0x02,0x02,0x02,0x02,0x02,0x02,0x03},
	{0xF0,0xFC,0x04,0x04,0x04,0x04,0x04,0x04,0x04,0xF4,0x04,0xFC,0x00,0x03,0x02,0x02,0x02,0x02,0x02,0x02,0x02,0x02,0x02,0x03},
	{0xF0,0xFC,0x04,0x04,0x04,0x04,0x04,0xF4,0x04,0xF4,0x04,0xFC,0x00,0x03,0x02,0x02,0x02,0x02,0x02,0x02,0x02,0x02,0x02,0x03},
	{0xF0,0xFC,0x04,0x04,0x04,0xF4,0x04,0xF4,0x04,0xF4,0x04,0xFC,0x00,0x03,0x02,0x02,0x02,0x02,0x02,0x02,0x02,0x02,0x02,0x03},
	{0xF0,0xFC,0x04,0xF4,0x04,0xF4,0x04,0xF4,0x04,0xF4,0x04,0xFC,0x00,0x03,0x02,0x02,0x02,0x02,0x02,0x02,0x02,0x02,0x02,0x03}
};

static void DisplayElectricity(int temp)
{
	if(temp<6500)temp=0;
	else if(temp>=6500&&temp<7000)temp=1;
	else if(temp>=7000&&temp<7500)temp=2;
	else if(temp>=7500&&temp<8000)temp=3;
	else temp=4;

	draw_pic(pstr[temp],116,0,12,12);
}


static void DisplayPleaseCharge(void)
{
	static char timecnt;
	unsigned char keyval;

	timecnt++;
	if(timecnt>55/5){
		timecnt=0;
		clear_lcd();
		DrawTitle_to_row_Language2(2,"电量不足，请充电","Please Charge");

		KeyIsResponse();
		while(1){
			keyval=GetKeyValue();
			if(keyval!=KEY_NONE)break;
		}
		InitFlag=1;
	}
}

static void DisplaySignalQuality(int temp)
{
	const unsigned char pstr[6][24]={
		{0x06,0x0A,0x3E,0x0A,0x06,0x00,0x00,0x00,0x00,0x00,0x00,0x00,0x00,0x02,0x00,0x00,0x00,0x00,0x00,0x00,0x00,0x00,0x00,0x00},
		{0x06,0x0A,0x3E,0x8A,0x06,0x00,0x00,0x00,0x00,0x00,0x00,0x00,0x00,0x02,0x00,0x03,0x00,0x00,0x00,0x00,0x00,0x00,0x00,0x00},
		{0x06,0x0A,0x3E,0x8A,0x06,0xE0,0x00,0x00,0x00,0x00,0x00,0x00,0x00,0x02,0x00,0x03,0x00,0x03,0x00,0x00,0x00,0x00,0x00,0x00},
		{0x06,0x0A,0x3E,0x8A,0x06,0xE0,0x00,0xF0,0x00,0x00,0x00,0x00,0x00,0x02,0x00,0x03,0x00,0x03,0x00,0x03,0x00,0x00,0x00,0x00},
		{0x06,0x0A,0x3E,0x8A,0x06,0xE0,0x00,0xF0,0x00,0xFC,0x00,0x00,0x00,0x02,0x00,0x03,0x00,0x03,0x00,0x03,0x00,0x03,0x00,0x00},
		{0x06,0x0A,0x3E,0x8A,0x06,0xE0,0x00,0xF0,0x00,0xFC,0x00,0xFF,0x00,0x02,0x00,0x03,0x00,0x03,0x00,0x03,0x00,0x03,0x00,0x03}
	};

	if(temp>32){
		temp=0;
	}else{
		temp/=5;
		if(temp>5)temp=5;
	}

	draw_pic(pstr[temp],0,0,12,12);
}


void UpgradeSignalQuality (void)
{
	unsigned char Buf[100];
	char *p;
	unsigned char retval;

	static int SignalQuality;

	if(ATsendreceive_Lock==1)
	{
		DisplaySignalQuality (SignalQuality);
		return;
	}
	else
	{
		kmy_EnableDisableTime3(0);
			
		strcpy ( (char*) Buf, "AT+CSQ\r");	//check signal quality
		retval = send_at_cmd_and_receive (Buf, sizeof (Buf) - 3, 100, "OK");
	
		if (retval == TCP_OK)
		{
			p = strstr ( (char *) Buf, "+CSQ: ");
	
			if (p != NULL)
			{
				SignalQuality = atoi (p + sizeof ("+CSQ: ") - 1);
				DisplaySignalQuality (SignalQuality);
			}
		}
		
		kmy_EnableDisableTime3(1);
	}
	
}

void UpgradeWiFiSignal(void)
{
	static unsigned char WiFi_Signal=0;
	static int cnt=0;	
	char *p;
	
	if(FirstGetSSID)return;
	if(ATsendreceive_Lock==1)
	{
		DisplayWiFiSignal(WiFi_Signal);
		return;
	}
	else
	{
		kmy_EnableDisableTime3(0);
	    if((rak_get_rssi()!=RUN_OK)||(strlen((char *)SSID)==0))
		{
			cnt++;
			if(cnt==5)
			{
			    cnt=0;
				InitFlag = 1;
				clear_lcd();
				DrawTitle_to_row(2,"Lose wifi");
				DrawTitle_to_row(3,"Try to reconnect");
			    rak_reset();
                kmy_WifiInit();    
			}
			kmy_EnableDisableTime3(1);
			return;
		}
		else
		{
		    cnt=0;
		}

        p=(char*)&uCmdRspFrame.getrssiResponse.rssi;
	    WiFi_Signal=((signed char)*p+113)/2;
	    printf("%s【%d】\r\n",SSID,WiFi_Signal);
	    DisplayWiFiSignal(WiFi_Signal);
		kmy_EnableDisableTime3(1);
	}
}


static void DisplayChargeElectricity(void)
{
	static unsigned char cnt;

	cnt++;
	if(cnt>4)cnt=0;

	draw_pic(pstr[cnt],116,0,12,12);
}

static unsigned char chargeflag;
void UpgradeElectricity(void)
{
	char HaveAcPowerFlag=0;
	static uint16_t Electricity;
	static unsigned char AcNewIn=1;

	Electricity= kmyGetVoltage(); 	

	HaveAcPowerFlag=kmy_BatGetACStatus();	
	
	if(HaveAcPowerFlag==AcStatus_Plug)	
	{
		if(Electricity<8280)
		{			
			if(Electricity>1200)
			{
			    
				if(kmy_BatGetChargeStatus()==ChargeStatus_Charge)
				{
					chargeflag=1;
				}
			}
			else
			{
				chargeflag=0;
				clear_area(116,0,12,12);
			}
			
		}
		else
		{
		
			if(Electricity>=8340&&AcNewIn==1)//&&(kmy_BatGetChargeStatus()==ChargeStatus_Charge))
			{
				AcNewIn=0;
				clear_lcd();
				DrawTitle_to_row_Language2(2,"电池电量已充满","Electricity Full");
				WaitkeyAndAutoExit(2000);
				InitFlag = 1;				
			}
			DisplayElectricity(Electricity);
			chargeflag=0;
		}
	}
	else
	{	
		if(Electricity>6700)
		{			
			DisplayElectricity(Electricity);  
		}
		else                   
		{	
		    DisplayPleaseCharge();          
			DisplayElectricity(Electricity);  
		}
		AcNewIn=1;
		chargeflag=0;
	}
}


void UpgradeCSPN (void)
{
	unsigned char Buf[100];
	unsigned char retval;
	char *p;
	const unsigned char *p2;
	static unsigned char CSPNbuf[20]={0};

	if(ATsendreceive_Lock==1)
	{
		DrawTitle_to_row_Language2 (0, CSPNbuf, CSPNbuf);
		return;
	}
	else
	{
		kmy_EnableDisableTime3(0);

		strcpy ( (char*) Buf, "AT+COPS?\r");
		retval = send_at_cmd_and_receive (Buf, sizeof (Buf) - 3, 100, "OK");

		if (retval == TCP_OK)
		{
			//+COPS: 0,0,"CHINA MOBILE"
			p = strstr ( (const char *) Buf, "COPS");

			if (p != NULL)
			{
				p = strstr ( (const char *) p, "\"");

				if (p != NULL)
				{
					p++;
					my_strcpy_EncounterHexEnd (Buf, (unsigned char*) p, 16, '\"');
				}
				else
				{
					strcpy ( (char *) Buf, "Searching net");
				}
			}
			else
			{
				strcpy ( (char *) Buf, "Searching net");
			}

			clear_area (20, 0, 84, 12);
			p2 = GetNetName (Buf);
			strcpy((char*)CSPNbuf,(char*)Buf);
			DrawTitle_to_row_Language2 (0, p2, Buf);
		}
		kmy_EnableDisableTime3(1);
	}
}

void UpgradeNetworkState(void)
{
	if(Net_ONOFF==1||Net_State==0)
	{
	    clear_area (74, 20, 48, 12);
		text_out(74, 20,"Off Line");
	}
	else
	{
	    clear_area (74, 20, 48, 12);
		text_out(74, 20,"On Line");
	}
}

void GetWiFiStatus(void)
{
	if(WiFiState&&strlen((char*)SSID))
	{
		clear_area_to_row(4,5);
		DrawTitle_to_row_Language2 (4, "连接", "CONNECTED");
	}
	else
	{
		clear_area_to_row(4,5);
		DrawTitle_to_row_Language2 (4, "未连接", "DISCONNECTED");
	}
}


static char ProcStandbyKey(char *msg)
{
	unsigned char keyval;
	unsigned char Buf[100];
	unsigned long cnt;
	static unsigned long PrevSeconds;
	static unsigned char powerdowntimecnt=0;
	
	if(InitFlag)
	{		// 初次调用初始化界面
		InitFlag = 0;	// 这个标志要放在这个地方
		clear_lcd();
		PrevSeconds=kmy_TimeGetRtcSeconds();		//更新日期时间
		DisplayHourMinuteSecond(PrevSeconds);
		DisplayYearMothDayWeek(PrevSeconds);
		kmy_NetStateSet();
		UpgradeNetworkState();	
		
		UpgradeElectricity();	//更新电池电量
		if(chargeflag)DisplayChargeElectricity();
			
	//	draw_pic(logo,74,20,52,18);
	    strcpy((char *)Buf,(char *)(&VersionString[5]));
		text_out(74,40,Buf);  
		if(NetworkSwitch[0]==WiFi)
		{
            GetWiFiStatus();
    		UpgradeWiFiSignal();	//更新WiFi信号量
			if(strlen((char*)SSID)==0)DrawTitle_to_row(0,"No WiFi Connect");
			else DrawTitle_to_row(0,SSID);
		}
		else
		{
			UpgradeSignalQuality();	//更新信号质量
			UpgradeCSPN();			//显示中国移动或中国联通			
			DrawTitle_to_row_Language2 (4, "Wireless terminal", "Wireless terminal");
		}
		powerdowntimecnt=0;
	}
	else
	{
		cnt=kmy_TimeGetRtcSeconds();			//更新日期时间
		if(PrevSeconds!=cnt)
		{
			PrevSeconds=cnt;
			DisplayHourMinuteSecond(PrevSeconds);
			DisplayYearMothDayWeek(PrevSeconds);
			cnt=PrevSeconds%4;
			UpgradeElectricity();	//更新电池电量
			if(chargeflag)DisplayChargeElectricity();
			
			if(cnt==0)
			{
				if(NetworkSwitch[0]==WiFi)
				{
					UpgradeWiFiSignal();	//更新WiFi信号量
					GetWiFiStatus();
					if(strlen((char*)SSID)==0)DrawTitle_to_row(0,"No WiFi Connect");
					else DrawTitle_to_row(0,SSID);
				}
        		else
        		{
        			UpgradeSignalQuality();	//更新信号质量
        			UpgradeCSPN();			//显示中国移动或中国联通
        		}		
			}
			else if(cnt==1)
			{				
                UpgradeNetworkState();
			}
			else if (cnt == 2)
			{						
				if(CheckOrderFailWarn()==0)
				{
					keyval=HaveReceiveOrder();
					if(keyval==KEY_Enter)
					{
						Latest_Orders(NULL);
						CurProc= ProcStandbyKey;
						InitFlag = 1;
					}
					if(keyval!=0)
					{
						InitFlag=1;
					}
				}
				else
				{
					InitFlag=1;
				}
			}
			else if(cnt == 3)
			{   
			    if(Upgrade_Flag[0]=='1')
		        {
    			    keyval=HaveUpgrade();
    				if(keyval==KEY_Enter)
    				{
    					CurProc= ProcStandbyKey;
    					InitFlag = 1;
    				}
    				if(keyval!=0)
    				{
    					InitFlag=1;
    				}
			    }
			}
			else
			{

			}

			powerdowntimecnt++;
			if(powerdowntimecnt>30)gEnterPowerDownFlag=1; //进入停止模式----zj
		}
	}

	keyval=GetKeyValue();
	if(keyval == KEY_NONE||keyval == KEY_WaitTimeout)return KEY_NONE;
	powerdowntimecnt=0;
	kmy_LcdBlackLightOn();			//检测到有按键按下，点亮LCD	---ZJ
	kmy_AutoOffLcdLight(10);		//10S后关闭背光
	kmy_AutoPostKey(10);			//10S后产生一个KEY_WaitTimeout
	StandbyResponseUserMenu(keyval);   //扫描键盘

	KeyIsResponse();
	return KEY_NONE;
}

unsigned char ApplicationInit(void)
{
	u8 retval;
	unsigned char Buf[50] = {'\0'};

	kmy_RCCInit();

	kmy_USART1Init(115200);	//把这个放在前面，是怕以下的初始化函数中包含printf语句

	kmy_LedInit();

	kmy_LcdInit();
	kmy_LcdBlackLightOn();
	kmy_LcdClear();
//	kmy_LcdDrawBitMap(PoweronLogo,0,0,128,64);	 
	DrawTitle_to_row(2,"Initializing...");
	kmy_KeyInit();

	kmy_BeepInit();

	kmy_TimeInit();

	kmy_FlashInit();
	
	kmy_GprsInit();

	kmy_EepromInit();

	//如果是空芯片则格式化eeprom
	if(kmy_EepromCheckWhetherBlankChip()==1){EepromFile_FileSystemFormat();}

	kmy_MagcardInit();

	kmy_MiscInit();

	kmy_BatInit();
	
	kmy_psamInit();
	
	kmyAdcInit();

	msleep(1000);

	kmy_PrinterInit(0);

	retval=EepromFile_CheckFileExist(efile_Config);
	if(retval==EepromFile_FileNameToLong)
	{
		clear_lcd();
		DrawTitle_to_row_Language2(2,"配置文件名太长","FileName too long");
	}
	else if(retval==EepromFile_HaveThisFile)
	{
		retval=RestoreGlobalVariable();
		if(retval!=1)
		{
			clear_lcd();
			DrawTitle_to_row_Language2(2,"恢复全局变量失败","Restore Variable Fail");
			EepromFile_FileSystemFormat();
			RestoreConfigFile();
			WaitkeyAndAutoExit(2);
			NVIC_SystemReset();
		}
	}
	else if(retval==EepromFile_HaveNotThisFile)
	{
	    EepromFile_FileSystemFormat();
		retval=RestoreConfigFile();
		if(retval!=1)
		{
			clear_lcd();
			DrawTitle_to_row_Language2(2,"恢复配置文件失败","Restore File Fail");
			WaitkeyAndAutoExit(2);
			NVIC_SystemReset();
		}
	}
#ifndef HaveWiFiModule
	NetworkSwitch[0]=GPRS;
#endif
    if(NetworkSwitch[0]==WiFi)
    {
		kmy_GprsOnOff(0);
    	if(kmy_WifiInit())
    	{
			clear_lcd();
        	DrawTitle_to_row_Language2(2,"WiFi模块","WiFi module");
        	DrawTitle_to_row_Language2(3,"初始化失败","Init failure!");
			WaitkeyAndAutoExit(10);
		}
		printf("WiFi Mode\r\n");
    }
	else
	{
		msleep(1000);
		Sim900B_init();	
		printf("GPRS Mode\r\n");
	}

	set_contrast (atoi ( (const char*)LightPercent) );
	
    if(PrintDensity[0]<'0'||PrintDensity[0]>'9')
    {
        strcpy((char*)PrintDensity,"2");    
    }
	Buf[0]=0x10;Buf[1]=0x05;Buf[2]=0x05;Buf[3]=atoi((char*)PrintDensity);
    kmy_PrinterSetcommand((char*)Buf,4);

	kmy_BackUpInit();
	if(SYNC_Time()<0)
    printf("sync time Failed!\n");
    printf("sync time Succeed!\n");
	
	printf("\r\n-----Init OK!-----\r\n");

	

	


	
	return 1;
}



void DestroyFunc(void)
{
	unsigned char secretkey[6]={0}; 	//解锁密钥号码
	//unsigned char secretflag[2]={0xa5,0x3c};
	unsigned char temp;
	unsigned char count=0;
	unsigned int retval;

	clear_lcd();
	DrawTitle_to_row_Language2(2,"非法拆机","Illegal open");
	DrawTitle_to_row_Language2(3,"芯片已自毁","Chip destroied");

	while(1){
		retval=kmy_GetKeyValue();
		if(retval==KEY_NONE)continue;
		BeepNormal();
		switch(retval)
		{
			case KEY1 : temp='1';printf("key is 1 \r\n");break;
			case KEY2 : temp='2';printf("key is 2 \r\n");break;
			case KEY3 : temp='3';printf("key is 3 \r\n");break;
			case KEY4 : temp='4';printf("key is 4 \r\n");break;
			case KEY5 : temp='5';printf("key is 5 \r\n");break;
			case KEY6 : temp='6';printf("key is 6 \r\n");break;
			case KEY7 : temp='7';printf("key is 7 \r\n");break;
			case KEY8 : temp='8';printf("key is 8 \r\n");break;
			case KEY9 : temp='9';printf("key is 9 \r\n");break;
			case KEY0 : temp='0';printf("key is 0 \r\n");break;
			case KEYJING :
			temp='#';printf("key is JING \r\n");
			break;
			case KEYXING :
			memset(secretkey,0,sizeof(secretkey));
			count=0;
			printf("key is XING \r\n");
			continue;
			default: break;
		}

		if(count<sizeof(secretkey)-1){
			secretkey[count]=temp;
			count++;
			if(strcmp((const char *)secretkey,"#123#")==0){
				kmy_ClearTamper();
				printf("unlock!!!\r\n");
				return;
			}
		}
		else{
			memset(secretkey,0,sizeof(secretkey));
			count=0;
		}
	}
}

void kmy_TIM3Init(void)
{
	TIM_ITConfig(TIM3,TIM_IT_Update,ENABLE);
	TIM_Cmd(TIM3, ENABLE);
}

#if 1
int main(void)
{
	ApplicationInit();
	kmy_LcdBlackLightOn();
	kmy_AutoOffLcdLight(20);
	kmy_TIM3Init();
	CurProc=ProcStandbyKey;

	while(1)
	{
		CurProc(NULL);
	/*	
		if(kmy_CheckTamper()==TAMPER_TRIGGERED)
		{
			DestroyFunc();
			InitFlag=1;
		}
		if(gEnterPowerDownFlag==1)		 //进入停止模式----zj
		{
		    if(NetworkSwitch[0]==WiFi)kmy_WiFiOnOff (0);    
			kmy_EnterPowerDownMode();
			gEnterPowerDownFlag=0;
			InitFlag=1;
			kmy_LcdBlackLightOn();			
		    if(NetworkSwitch[0]==WiFi)kmy_WiFiOnOff (1);    
		}
	*/
	}
}
#endif


